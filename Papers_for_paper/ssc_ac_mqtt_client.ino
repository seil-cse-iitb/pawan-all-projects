#include <IRremoteESP8266.h>
#include "ESP8266WiFi.h"
#include <PubSubClient.h>

int khz = 38; // 38kHz carrier frequency for both NEC and Samsung

const char* ssid = "Pi_AP";
const char* password = "Raspberry";

const char* mqtt_server = "192.168.42.1"; //  "10.129.28.158";  // Shaunak' laptop: "192.168.1.117";
const char* mqtt_username = "<MQTT_BROKER_USERNAME>";
const char* mqtt_password = "<MQTT_BROKER_PASSWORD>";

//const char* mqtt_topic = "nodemcu/+/last_state";
const char* mqtt_topic = "nodemcu/SCC/AC";
const char* client_id = "AC_3";

WiFiServer server(80);
WiFiClient espClient;
PubSubClient client(espClient);

// Static IP details...
/*
  IPAddress ip(192, 168, 1, 171);
  IPAddress gateway(192, 168, 1, 1);
  IPAddress subnet(255, 255, 255, 0);
  IPAddress DNS(192, 168, 1, 1);
*/

//IRsend irsend(4); //an IR led is connected to GPIO4 (pin D2 on NodeMCU)
IRsend irsend(D2);

int AC_INPUT = D1; // digital input pin, active LOW logic
int AC_VAL = 0;    // variale to store status of AC_INPUT pin
int AC_STATE = 1; // initializing  ac_state variable such that when RPi code is started, it helps arduino to turn the IDUs OFF.

int ledPin = D7;

// Hitachi VRF - SEIL Lab
//unsigned int Signal_ON[] = {3488, 1584, 548, 1184, 520, 348, 520, 348, 544, 348, 520, 344, 524,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 320, 548};
//unsigned int Signal_OFF[] = {3488, 1608, 544, 1160, 524, 372, 544, 320, 548, 320, 520, 372, 520,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 320, 544};



// O-General
unsigned int Signal_ON[] = {3388, 1508, 496, 320, 524, 296, 520, 1112, 520, 296, 496, 1136, 524,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 296, 520};
unsigned int Signal_OFF[] = {3392, 1532, 520, 296, 496, 320, 524, 1112, 496, 320, 496, 1136, 520,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 1120, 512};

void setupWifi()
{
  delay(10);
  // Connect to WiFi network
  Serial.println();
  Serial.println();
  Serial.print("Connecting to ");
  Serial.println(ssid);
  // Static IP Setup Info Here...
  //WiFi.config(ip, gateway, subnet, DNS);

  delay(100);
  WiFi.begin(ssid, password);

  while (WiFi.status() != WL_CONNECTED) {
    delay(500);
    Serial.print(".");
  }
  Serial.println();
  Serial.print("Connected to WiFi with IP ");
  Serial.println(WiFi.localIP());
}

void callback(char* topic, byte* payload, unsigned int length)
{
  Serial.print("Message from topic [");
  Serial.print(topic);
  Serial.print("] : ");
  Serial.println(length);

  
  //Serial.println(payload);
  
  if (payload[0] == 'A')
  {
    if (payload[2] == '1')
    {
      //digitalWrite(ledPin, HIGH);
      Serial.println("LED HIGH");
      turn_on_AC();
    }
    else if (payload[2] == '0')
    {
      //digitalWrite(ledPin, LOW);
      Serial.println("LED LOW");
      turn_off_AC();
    }
  }
  else
  {
    Serial.println("Data not for AC");
  }
}

void reconnect()
{
  while (!client.connected())
  {
    Serial.print("Connecting to MQTT....");

    if (client.connect(client_id))//, mqtt_username, mqtt_password))
    {
      Serial.println("Connected");
      client.subscribe(mqtt_topic);
    }
    else
    {
      Serial.print("Failed to connect");
      Serial.println(client.state());
      delay(5000);
    }
  }
}


void setup() {
  pinMode(AC_INPUT, INPUT);
  Serial.begin(9600);
  delay(10);

  irsend.begin();

  Serial.println("let us begin");
  Serial.println("TURN ON = 1, TURN OFF = 0");

  int ledPin = 13; // GPIO13
  //WiFiServer server(80);

  pinMode(ledPin, OUTPUT);
  digitalWrite(ledPin, LOW);

  // Connecting to WiFi
  setupWifi();

  // Initializing MQTT server
  client.setServer(mqtt_server, 1883);
  client.setCallback(callback);
  Serial.println(mqtt_topic);
  // Start the server

  server.begin();
  Serial.println("Server started");

  // Print the IP address
  /*
    Serial.print("Use this URL to connect: ");
    Serial.print("http://");
    Serial.print(WiFi.localIP());
    Serial.println("/");
    Serial.print(WiFi.gatewayIP().toString());
    Serial.println("/");
  */
}

void turn_on_AC()
{
  Serial.println("Turning ON");
  irsend.sendRaw(Signal_ON, sizeof(Signal_ON) / sizeof(int), khz); // Sends ON code
}

void turn_off_AC()
{
  Serial.println("Turning OFF");
  irsend.sendRaw(Signal_OFF, sizeof(Signal_OFF) / sizeof(int), khz); // Sends OFF Code
}

void loop() {

  if (!client.connected())
  {
    reconnect();
  }

  client.loop();

  delay(10);
}

